## sdkconfig.defaults
```kconfig
# Override some defaults so BT stack is enabled
# in this example

CONFIG_IDF_TARGET="esp32c2"

# CONFIG_APP_PROJECT_VER_FROM_CONFIG=y


CONFIG_ESPTOOLPY_MONITOR_BAUD=460800
CONFIG_ESP_CONSOLE_UART_BAUDRATE=460800

CONFIG_XTAL_FREQ_26=y
CONFIG_XTAL_FREQ=26

CONFIG_ESPTOOLPY_FLASHSIZE_4MB=y


# Partition Table
CONFIG_PARTITION_TABLE_CUSTOM=y
CONFIG_PARTITION_TABLE_CUSTOM_FILENAME="partitions.csv"
CONFIG_PARTITION_TABLE_FILENAME="partitions.csv"

CONFIG_BOOTLOADER_APP_ROLLBACK_ENABLE=y


#
# BT config
#
CONFIG_BT_ENABLED=y
CONFIG_BT_NIMBLE_ENABLED=y
CONFIG_BT_BLUEDROID_ENABLED=n
CONFIG_BTDM_CTRL_MODE_BLE_ONLY=y
CONFIG_BTDM_CTRL_MODE_BR_EDR_ONLY=n
CONFIG_BTDM_CTRL_MODE_BTDM=n

CONFIG_BT_NIMBLE_HCI_EVT_BUF_SIZE=70
CONFIG_BT_NIMBLE_EXT_ADV=n

# Optimizations
CONFIG_BT_NIMBLE_SECURITY_ENABLE=n
# CONFIG_BT_NIMBLE_MAX_CONNECTIONS=1
# CONFIG_BT_NIMBLE_ROLE_CENTRAL=n
# CONFIG_BT_NIMBLE_ROLE_OBSERVER=n



#
# IoT Button
#
CONFIG_BUTTON_PERIOD_TIME_MS=5
CONFIG_BUTTON_DEBOUNCE_TICKS=2
CONFIG_BUTTON_SHORT_PRESS_TIME_MS=180
CONFIG_BUTTON_LONG_PRESS_TIME_MS=700
CONFIG_BUTTON_LONG_PRESS_HOLD_SERIAL_TIME_MS=500
# CONFIG_ADC_BUTTON_MAX_CHANNEL=3
# CONFIG_ADC_BUTTON_MAX_BUTTON_PER_CHANNEL=8
# CONFIG_ADC_BUTTON_SAMPLE_TIMES=1
# end of IoT Button
```
